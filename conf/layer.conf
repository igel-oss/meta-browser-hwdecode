## conf/layer.conf
```bitbake
# We have a conf and classes directory, add to BBPATH
BBPATH .= ":${LAYERDIR}"

# We have recipes-* directories, add to BBFILES
BBFILES += "${LAYERDIR}/recipes-*/*/*.bb \
    ${LAYERDIR}/recipes-*/*/*.bbappend"

BBFILE_COLLECTIONS += "browser-hwdecode"
BBFILE_PATTERN_browser-hwdecode = "^${LAYERDIR}/"
BBFILE_PRIORITY_browser-hwdecode = "6"
```
